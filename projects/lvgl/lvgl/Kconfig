## projects/lvgl/lvgl/Kconfig
```kconfig
# Display drivers

# Copyright (c) 2017 Intel Corporation
# SPDX-License-Identifier: Apache-2.0

source "Kconfig.zephyr"

menu "Alientek Pandora Board Config"

module = DISPLAY
module-str = display
rsource "drivers/display/Kconfig.st7789v"

endmenu
```

## projects/lvgl/lvgl/dts/bindings/display/curstom,st7789v.yaml
```yaml
# Copyright (c) 2019, Marc Reilly <marc@cpdesign.com.au>
# Copyright (c) 2019, PHYTEC Messtechnik GmbH
# SPDX-License-Identifier: Apache-2.0

description: ST7789V 320x240 display controller

compatible: "curstom,st7789v"

include: ["sitronix,st7789v.yaml"]

properties:
  bl-ctrl-gpios:
    type: phandle-array
    description: |
      Backlight on/off GPIO pin.
      Configure the GPIO polarity (active high/active low) according to LCD datasheet.
```

## west.yml
```yaml
manifest:
  self:
    west-commands: scripts/west-commands.yml

  remotes:
    - name: zephyrproject-rtos
      url-base: https://github.com/zephyrproject-rtos

  projects:
    - name: zephyr
      remote: zephyrproject-rtos
      revision: c975951aff28af68bc1a67a333f67f8a1366eaee
      # clone-depth: 10
      path: zephyr
      import:
        # By using name-allowlist we can clone only the modules that are
        # strictly needed by the application.
        name-allowlist:
          - cmsis      # required by the ARM port
          - hal_stm32  # required by the nucleo_f302r8 board (STM32 based)
```
