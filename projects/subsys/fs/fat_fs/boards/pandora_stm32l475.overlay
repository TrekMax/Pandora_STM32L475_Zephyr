/*
 * Copyright (c) 2023 Łukasz Hejnak (LeHack) <lehack-ghub@lehack.pl>
 *
 * SPDX-License-Identifier: Apache-2.0
 */

&spi1 {
        pinctrl-0 = <&spi1_miso_pa6
        &spi1_mosi_pa7
        &spi1_sck_pa5>;
        pinctrl-names = "default";
        status = "okay";
        cs-gpios = <&gpioc 3 (GPIO_ACTIVE_HIGH | GPIO_PULL_UP)>;
        sdhc0: sdhc@0 {
                compatible = "zephyr,sdhc-spi-slot";
                reg = <0>;
                status = "okay";
                mmc {
                        compatible = "zephyr,sdmmc-disk";
                        status = "okay";
                };
                spi-max-frequency = <25000000>;
                spi-clock-mode-cpol;
                spi-clock-mode-cpha;
        };
};
